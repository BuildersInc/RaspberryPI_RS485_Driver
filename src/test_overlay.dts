/dts-v1/;
/plugin/;
/ {
    compatible = "bcrm, bcm2835";
    fragment@0 {
        target = "/";
        __overlay__ {
            my_device {
                compatible = "brightlight, RASPI_RS485";
                status = "okay";
                label = "Test";
                my_value = <12>;
            };
        };
    };
};